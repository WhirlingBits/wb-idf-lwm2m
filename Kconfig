## Kconfig
```kconfig
menu "WhirlingBits LWM2M Client"

    config WB_LWM2M_DEFAULT_LIFETIME
        int "Default registration lifetime (seconds)"
        default 86400
        help
            Default LWM2M registration lifetime in seconds.
            The client will send periodic Registration Update requests
            before this expires. Common values: 300 (5min), 3600 (1h), 86400 (24h).

    config WB_LWM2M_DEFAULT_BINDING
        string "Default binding mode"
        default "U"
        help
            LWM2M binding mode. "U" = UDP, "UQ" = UDP with Queue Mode.

    config WB_LWM2M_DEFAULT_VERSION
        string "Default LWM2M version"
        default "1.0"
        help
            LWM2M protocol version. Supported: "1.0", "1.1".

    config WB_LWM2M_MAX_OBJECTS
        int "Maximum number of LWM2M objects"
        default 16
        help
            Maximum number of LWM2M objects that can be registered with the client.

endmenu
```

## example/main/Kconfig.projbuild
```kconfig
menu "Example Configuration"

    config EXAMPLE_WIFI_SSID
        string "WiFi SSID"
        default "Wokwi-GUEST"
        help
            WiFi SSID to connect to.

    config EXAMPLE_WIFI_PASSWORD
        string "WiFi Password"
        default ""
        help
            WiFi password (WPA2). Leave empty for open networks.

    config EXAMPLE_LWM2M_SERVER_URI
        string "LwM2M Server URI"
        default "coaps://iot.whirlingbits.de:5684"
        help
            LwM2M server URI, e.g. coap://host:5683 or coaps://host:5684.

    config EXAMPLE_LWM2M_ENDPOINT_NAME
        string "LwM2M Endpoint Name"
        default "test"
        help
            Endpoint name (ep query parameter during registration).

    config EXAMPLE_LWM2M_LIFETIME
        int "LwM2M Lifetime (seconds)"
        range 60 86400
        default 300
        help
            Registration lifetime sent to the server.

    config EXAMPLE_LWM2M_PSK_IDENTITY
        string "DTLS PSK Identity"
        default "test"
        help
            PSK identity string expected by the LwM2M server.

    config EXAMPLE_LWM2M_PSK_KEY_HEX
        string "DTLS PSK Key (hex)"
        default "b6453986e89004cd6d6159c1fe17bebe0008ec8e8914acfbebb1fe82879d87c5"
        help
            PSK key as hex string without 0x prefix or separators.

    config EXAMPLE_NVS_NAMESPACE
        string "NVS namespace for runtime overrides"
        default "lwm2m"
        help
            NVS namespace used to override the Kconfig defaults at runtime.

endmenu
```

## example/sdkconfig.defaults
```kconfig
CONFIG_IDF_TARGET="esp32s3"

# Common defaults for the LWM2M example
CONFIG_COAP_MBEDTLS_PSK=y
CONFIG_LWIP_DNS_SUPPORT_MDNS_QUERIES=y

# DTLS support (required by CoAP/LWM2M)
CONFIG_MBEDTLS_SSL_PROTO_DTLS=y
CONFIG_MBEDTLS_SSL_COOKIE_C=y

# PSK support in mbedTLS (required for DTLS-PSK)
CONFIG_ESP_TLS_PSK_VERIFICATION=y
CONFIG_MBEDTLS_PSK_MODES=y
CONFIG_MBEDTLS_KEY_EXCHANGE_PSK=y
CONFIG_MBEDTLS_KEY_EXCHANGE_ECDHE_PSK=y

# CoAP wrapper defaults
CONFIG_WB_COAP_TASK_STACK_SIZE=8192
CONFIG_WB_COAP_TASK_PRIORITY=5
CONFIG_WB_COAP_REQUEST_QUEUE_SIZE=8

# lwIP
CONFIG_LWIP_DNS_SUPPORT_MDNS_QUERIES=y
```
